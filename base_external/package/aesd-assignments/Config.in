## base_external/package/aesd-assignments/Config.in
```kconfig
config BR2_PACKAGE_AESD_ASSIGNMENTS
	bool "aesd-assignments"
	help
	  Includes the aesdsocket server executable, aesdchar character driver,
	  and associated startup scripts for automated driver and application loading.
```
